## examples/UnitUnified/UnitRTC/NTPSync/main/Kconfig.projbuild
```kconfig
# The "Target RTC" choice for this example.
rsource "../../../common/Kconfig.variant.ntpsync"

menu "NTPSync settings"

config EXAMPLE_WIFI_SSID
    string "Wi-Fi SSID"
    default ""
    help
        SSID to connect to. If empty, the station config stored in NVS is used.

config EXAMPLE_WIFI_PASSWORD
    string "Wi-Fi password"
    default ""

endmenu
```
